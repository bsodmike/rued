## sdkconfig.defaults
```kconfig
# Rust often needs a bit of an extra main task stack size compared to C (the default is 3K)
CONFIG_ESP_MAIN_TASK_STACK_SIZE=50000

CONFIG_ESP_SYSTEM_EVENT_TASK_STACK_SIZE=4096

# Use this to set FreeRTOS kernel tick frequency to 1000 Hz (100 Hz by default).
# This allows to use 1 ms granuality for thread sleeps (10 ms by default).
#CONFIG_FREERTOS_HZ=1000

# Workaround for https://github.com/espressif/esp-idf/issues/7631
#CONFIG_MBEDTLS_CERTIFICATE_BUNDLE=n
#CONFIG_MBEDTLS_CERTIFICATE_BUNDLE_DEFAULT_FULL=n

# Disable watchdog timers
CONFIG_INT_WDT=n
CONFIG_ESP_TASK_WDT=n

# Compile-time log levels
#CONFIG_LOG_DEFAULT_LEVEL_NONE=y
#CONFIG_LOG_DEFAULT_LEVEL_ERROR=y
#CONFIG_LOG_DEFAULT_LEVEL_WARN=y
#CONFIG_LOG_DEFAULT_LEVEL_INFO=y
#CONFIG_LOG_DEFAULT_LEVEL_DEBUG=y
#CONFIG_LOG_DEFAULT_LEVEL_VERBOSE=y

# Enable HTTP server websockets (necessary for web UI)
CONFIG_HTTPD_WS_SUPPORT=y

# Enable TLS
CONFIG_ESP_HTTPS_SERVER_ENABLE=y

# This is 10 by default. 16 is the maximum
CONFIG_LWIP_MAX_SOCKETS=16

# Enable the option to dispatch timer events directly from the timer ISR 
# (the executor & async timer wrapper of `esp-idf-svc` are compatible with this dispatch method)
# This has lower latency as compared to dispatching via an intermediate task
# SAFETY: currently there is a bug in esp-idf which results in a crash in
# long running tasks - so this needs to be disabled
CONFIG_ESP_TIMER_SUPPORTS_ISR_DISPATCH_METHOD=n

# Enable posting to event loops directly from an ISR 
# (the event loop wrapper of `esp-idf-svc` is compatible with this, including the async postbox wrapper)
CONFIG_ESP_EVENT_POST_FROM_ISR=y

# Configure SNTP
CONFIG_LWIP_SNTP_MAX_SERVERS=4
CONFIG_LWIP_SNTP_UPDATE_DELAY=15000
```
